## Kconfig
```kconfig
# The buzzer sits on the central (or a non-split keyboard) and behaviors run
# there too, so nothing is enabled for peripherals.

config ZMK_BUZZER
    bool
    default y
    depends on DT_HAS_ZMK_BUZZER_ENABLED
    depends on !ZMK_SPLIT || ZMK_SPLIT_ROLE_CENTRAL
    select PWM

config ZMK_BUZZER_INIT_PRIORITY
    int "Buzzer init priority"
    default 60
    depends on ZMK_BUZZER
    help
      Must come after the PWM driver (PWM_INIT_PRIORITY).

config ZMK_BEHAVIOR_BUZZER
    bool
    default y
    depends on DT_HAS_ZMK_BEHAVIOR_BUZZER_ENABLED
    depends on ZMK_BUZZER

config ZMK_BEHAVIOR_BUZZER_INIT_PRIORITY
    int "Buzzer behavior init priority"
    default 70
    depends on ZMK_BEHAVIOR_BUZZER
    help
      Must come after the buzzer (ZMK_BUZZER_INIT_PRIORITY).

config ZMK_BUZZER_TRIGGERS
    bool
    default y
    depends on DT_HAS_ZMK_BUZZER_TRIGGERS_ENABLED
    depends on ZMK_BUZZER

config ZMK_BUZZER_TEST_PWM
    bool
    default y
    depends on DT_HAS_ZMK_BUZZER_TEST_PWM_ENABLED
    depends on PWM
    help
      Logging PWM controller used by the native_sim tests.
```

## dts/bindings/behaviors/zmk,behavior-buzzer.yaml
```yaml
description: |
  Buzzer behavior: plays a melody of a zmk,buzzer on key press. The parameter
  is the melody number.

compatible: "zmk,behavior-buzzer"

include: one_param.yaml

properties:
  buzzer:
    type: phandle
    required: true
    description: The zmk,buzzer to play on
```

## dts/bindings/test/zmk,buzzer-test-pwm.yaml
```yaml
description: |
  Test-only PWM controller for native_sim: logs every period/pulse it is given
  (1 cycle = 1 us). Not for real hardware.

compatible: "zmk,buzzer-test-pwm"

include: [pwm-controller.yaml, base.yaml]

properties:
  "#pwm-cells":
    const: 2

pwm-cells:
  - channel
  - period
```

## dts/bindings/zmk,buzzer-triggers.yaml
```yaml
description: |
  Plays buzzer melodies on keyboard events. Each sound is a phandle to a
  melody node of a zmk,buzzer; leave a property out for no sound. At most one
  instance.

compatible: "zmk,buzzer-triggers"

properties:
  startup:
    type: phandle
    description: Played once at boot

  usb-connected:
    type: phandle
    description: |
      Played when a USB host enumerates the keyboard. When startup is set, the
      first connection after boot plays nothing, so the two don't clash.

  usb-disconnected:
    type: phandle
    description: Played when the USB host goes away

child-binding:
  description: Sounds for one layer
  properties:
    layer:
      type: int
      required: true
      description: Layer index

    "on":
      type: phandle
      description: Played when the layer turns on

    "off":
      type: phandle
      description: Played when the layer turns off
```

## dts/bindings/zmk,buzzer.yaml
```yaml
description: |
  Passive buzzer driven by a PWM channel, with melodies as child nodes.
  Melodies are numbered in the order they are defined, starting at 0.

compatible: "zmk,buzzer"

properties:
  pwms:
    type: phandle-array
    required: true
    description: |
      PWM channel driving the buzzer. The period cell is only a placeholder,
      each note sets its own, e.g. <&pwm0 0 PWM_HZ(1000) PWM_POLARITY_NORMAL>.

  duty-percent:
    type: int
    default: 50
    description: |
      Duty cycle of each note. 50 is loudest; lower values are quieter and
      thinner.

child-binding:
  description: A melody
  properties:
    notes:
      type: array
      required: true
      description: |
        Pairs of frequency (Hz) and duration (ms), e.g.
        <NOTE_C6 80 NOTE_REST 40 NOTE_G6 120> using the macros from
        <dt-bindings/zmk/buzzer.h>. A frequency of 0 (NOTE_REST) is silence.
        The buzzer is always silent once the melody ends.
```
